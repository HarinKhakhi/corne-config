## config/west.yml
```yaml
manifest:
  remotes:
    - name: zmkfirmware
      url-base: https://github.com/zmkfirmware
    - name: urob
      url-base: https://github.com/urob

  projects:
    - name: zmk-helpers
      remote: urob
      revision: main
      path: modules/helpers

    - name: zmk
      remote: urob
      import: app/west.yml
      revision: going-modular

  self:
    path: config
```
